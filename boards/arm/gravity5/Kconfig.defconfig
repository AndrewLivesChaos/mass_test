## boards/arm/gravity5/Kconfig.defconfig
```kconfig
# Copyright (c) 2023 Nordic Semiconductor ASA
# SPDX-License-Identifier: Apache-2.0

if BOARD_GRAVITY5

config BOARD
	default "gravity5"

config BT_CTLR
   default BT

endif
```
